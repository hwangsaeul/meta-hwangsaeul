## conf/layer.conf
```bitbake
# We have a conf and classes directory, add to BBPATH
BBPATH .= ":${LAYERDIR}"

# We have recipes-* directories, add to BBFILES
BBFILES += "${LAYERDIR}/recipes-*/*/*.bb \
            ${LAYERDIR}/recipes-*/*/*.bbappend"

BBFILE_COLLECTIONS += "meta-hwangsaeul"
BBFILE_PATTERN_meta-hwangsaeul = "^${LAYERDIR}/"
BBFILE_PRIORITY_meta-hwangsaeul = "6"

LAYERDEPENDS_meta-hwangsaeul = "core"
LAYERSERIES_COMPAT_meta-hwangsaeul = "honister"

PREFERRED_VERSION_linux-intel = "5.10%"
```
